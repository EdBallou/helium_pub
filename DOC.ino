//Sample code for an dangerously occupied car alerting system. 
//Untested, provided as a proof of concept code and generated by ChatGPT.
//No liability is assumed by the providing of this code in any application.
//For more information, check out my youtube channel: https://www.youtube.com/@edballou1

#include <Wire.h>
#include <RAK4631.h>
#include <RAK4630_ENV.h>
#include <Adafruit_Sensor.h>
#include <Adafruit_TSL2561_U.h>
#include <Adafruit_GPS.h>

RAK4631 rak;
RAK4630_ENV env;
Adafruit_TSL2561_Unified tsl = Adafruit_TSL2561_Unified(TSL2561_ADDR_FLOAT, 12345);
Adafruit_GPS GPS(&Serial1);

void setup() {
  rak.init();
  tsl.enableAutoRange(true);
  tsl.setIntegrationTime(TSL2561_INTEGRATIONTIME_101MS);
  Serial1.begin(9600);
  GPS.begin(9600);
  GPS.sendCommand(PMTK_SET_NMEA_OUTPUT_RMCGGA);
  GPS.sendCommand(PMTK_SET_NMEA_UPDATE_1HZ);
  env.begin();
}

void loop() {
  sensors_event_t event;
  tsl.getEvent(&event);

  if (event.light) {
    float temp = event.light / 1.0;
    rak.printf("Temperature: %f", temp);
    if (temp > 80) {
        rak.printf("ALERT: Temperature above 80 degrees at location: ");
        rak.printf("Latitude: %f, Longitude: %f", GPS.location.lat(), GPS.location.lng());
    } else if (temp > 70) {
        rak.printf("WARNING: Temperature above 70 degrees at location: ");
        rak.printf("Latitude: %f, Longitude: %f", GPS.location.lat(), GPS.location.lng());
    }
  }
  //Read the air quality data
  env.loop();
  if (env.airQuality() < 20) {
      rak.printf("ALERT: Air Quality is poor at location: ");
      rak.printf("Latitude: %f, Longitude: %f", GPS.location.lat(), GPS.location.lng());
  }
  else if (env.airQuality() < 50) {
      rak.printf("WARNING: Air Quality is moderate at location: ");
      rak.printf("Latitude: %f, Longitude: %f", GPS.location.lat(), GPS.location.lng());
  }

  if (GPS.newNMEAreceived()) {
    if (!GPS.parse(GPS.lastNMEA()))
        return;
  }
  delay(1000);
}
